## CMakeLists.txt
```
cmake_minimum_required(VERSION 3.20.0)
find_package(Zephyr REQUIRED HINTS $ENV{ZEPHYR_BASE})
project(usb_kbd_bridge)

include(${ZEPHYR_BASE}/samples/subsys/usb/common/common.cmake)

target_sources(app PRIVATE
	src/main.c
	src/kbd_bridge.c
	src/usb_host.c
	src/usbh_conf.c
)

set(USBH_MW $ENV{HOME}/zephyr/stm32-mw-usb-host)
target_sources(app PRIVATE
	${USBH_MW}/Core/Src/usbh_core.c
	${USBH_MW}/Core/Src/usbh_ctlreq.c
	${USBH_MW}/Core/Src/usbh_ioreq.c
	${USBH_MW}/Core/Src/usbh_pipes.c
	${USBH_MW}/Class/HID/Src/usbh_hid.c
	${USBH_MW}/Class/HID/Src/usbh_hid_keybd.c
	${USBH_MW}/Class/HID/Src/usbh_hid_mouse.c
	${USBH_MW}/Class/HID/Src/usbh_hid_parser.c
)
target_include_directories(app PRIVATE
	src
	${USBH_MW}/Core/Inc
	${USBH_MW}/Class/HID/Inc
)

target_sources(app PRIVATE
	${ZEPHYR_HAL_STM32_MODULE_DIR}/stm32cube/stm32n6xx/drivers/src/stm32n6xx_hal_hcd.c
)
```

## Kconfig
```
# Copyright (c) 2024
# SPDX-License-Identifier: Apache-2.0

source "samples/subsys/usb/common/Kconfig.sample_usbd"

source "Kconfig.zephyr"
```

## prj.conf
```kconfig
CONFIG_MAIN_STACK_SIZE=4096
CONFIG_LOG=y
CONFIG_LOG_BUFFER_SIZE=4096
CONFIG_HEAP_MEM_POOL_SIZE=8192

CONFIG_USB_DEVICE_STACK_NEXT=y
CONFIG_USBD_HID_SUPPORT=y
CONFIG_HWINFO=y
CONFIG_SAMPLE_USBD_MANUFACTURER="VicLab"
CONFIG_SAMPLE_USBD_PRODUCT="N6 USB Keyboard Bridge"
CONFIG_SAMPLE_USBD_PID=0x000A

CONFIG_LOG_DEFAULT_LEVEL=1
CONFIG_USBD_LOG_LEVEL_ERR=y
CONFIG_UDC_DRIVER_LOG_LEVEL_ERR=y
```

## app.overlay
```dts
/*
 * Step 3 overlay for stm32n6570_dk.
 *
 * Device side: zephyr_udc0 (usbotg_hs1) is enabled for the PC-facing port.
 * Host side:   OTG_HS2 is NOT in the DTS — we drive it directly via HAL,
 *              bypassing Zephyr's USB subsystem entirely.
 */

&zephyr_udc0 {
	status = "okay";
};

/ {
	hid_dev_0: hid_dev_0 {
		compatible = "zephyr,hid-device";
		label = "HID0";
		protocol-code = "keyboard";
		in-report-size = <64>;
		in-polling-period-us = <1000>;
	};
};
```

## src/main.c
```c
/*
 * USB HID Keyboard Bridge — STM32N6570-DK
 *
 * Bridges a USB keyboard (USB-A) to the PC (USB-C).
 * USER1 button toggles bridge on/off. LED2 indicates mode.
 */

#include "kbd_bridge.h"
#include "usb_host.h"

#include <zephyr/kernel.h>
#include <zephyr/logging/log.h>
#include <stm32n6xx_hal.h>

LOG_MODULE_REGISTER(main, LOG_LEVEL_INF);

int main(void)
{
	int ret;

	/* Step 1: Configure USB2 PHY clocks via LL API.
	 * Must happen before any USB init. HAL_RCCEx_PeriphCLKConfig()
	 * cannot be used — it disrupts USB1's shared HSE clock path.
	 */
	LL_RCC_SetOTGPHYClockSource(LL_RCC_OTGPHY2_CLKSOURCE_HSE_DIV_2);
	LL_RCC_SetOTGPHYCKREFClockSource(
		LL_RCC_OTGPHY2CKREF_CLKSOURCE_HSE_DIV_2_OSC);

	/* Step 2: Initialize USB device side (OTG_HS1 → PC).
	 * Enables VddUSB and shared clock infrastructure.
	 * Does NOT put USB1 on the bus yet.
	 */
	ret = kbd_bridge_init();
	if (ret) {
		LOG_ERR("kbd_bridge_init: %d", ret);
		return ret;
	}

	/* Step 3: Initialize USB host side (OTG_HS2 ← keyboard).
	 * Needs VddUSB from step 2. HAL_HCD_Init's USB_CoreReset
	 * is safe here because USB1 is not on the bus yet.
	 */
	ret = usb_host_start();
	if (ret) {
		LOG_ERR("usb_host_start: %d", ret);
	}

	/* Step 4: Enable USB device on the bus.
	 * PC will enumerate "VicLab N6 USB Keyboard Bridge".
	 */
	ret = kbd_bridge_enable();
	if (ret) {
		LOG_ERR("kbd_bridge_enable: %d", ret);
		return ret;
	}

	LOG_INF("USB keyboard bridge ready");

	/* Step 5: Run the bridge consumer loop (blocks forever). */
	kbd_bridge_run();

	return 0;
}
```

## src/kbd_bridge.c
```c
/*
 * USB HID Keyboard Bridge — device side (OTG_HS1 → PC).
 *
 * Registers a boot-protocol HID keyboard with Zephyr's USBD-next stack
 * and runs a consumer loop that forwards reports from the message queue
 * to the PC via hid_device_submit_report().
 */

#include "kbd_bridge.h"
#include "usb_host.h"

#include <sample_usbd.h>

#include <zephyr/kernel.h>
#include <zephyr/device.h>
#include <zephyr/usb/usbd.h>
#include <zephyr/usb/class/usbd_hid.h>
#include <zephyr/logging/log.h>

LOG_MODULE_REGISTER(kbd_bridge, LOG_LEVEL_INF);

/* Standard boot-protocol keyboard HID report descriptor. */
static const uint8_t hid_report_desc[] = HID_KEYBOARD_REPORT_DESC();

/* UDC static buffer for report submission (must be in DMA-safe memory). */
UDC_STATIC_BUF_DEFINE(submit_buf, KB_REPORT_SIZE);

/* Message queue: host callback produces, main thread consumes. */
K_MSGQ_DEFINE(kb_msgq, KB_REPORT_SIZE, 16, 4);

static const struct device *hid_dev;
static struct usbd_context *usbd_ctx;
static volatile bool hid_ready;
static uint32_t idle_duration;

/* ---- HID device callbacks ---- */

/* Called when the HID interface becomes ready/not ready. */
static void on_iface_ready(const struct device *dev, const bool ready)
{
	hid_ready = ready;
}

/* GET_REPORT: PC requests current keyboard state. */
static int on_get_report(const struct device *dev, const uint8_t type,
			 const uint8_t id, const uint16_t len,
			 uint8_t *const buf)
{
	if (len < KB_REPORT_SIZE) {
		return -ENOTSUP;
	}
	memset(buf, 0, KB_REPORT_SIZE);
	return KB_REPORT_SIZE;
}

/* SET_REPORT (output): PC sends LED state (NumLock, CapsLock, etc).
 * Forward to the physical keyboard via usb_host_set_kbd_leds(). */
static int on_set_report(const struct device *dev, const uint8_t type,
			 const uint8_t id, const uint16_t len,
			 const uint8_t *const buf)
{
	if (type != HID_REPORT_TYPE_OUTPUT || len < 1) {
		return -ENOTSUP;
	}
	usb_host_set_kbd_leds(buf[0]);
	return 0;
}

/* SET_IDLE / GET_IDLE: idle rate for report throttling. */
static void on_set_idle(const struct device *dev, const uint8_t id,
			const uint32_t duration)
{
	idle_duration = duration;
}

static uint32_t on_get_idle(const struct device *dev, const uint8_t id)
{
	return idle_duration;
}

/* SET_PROTOCOL: boot vs report protocol (we always use boot). */
static void on_set_protocol(const struct device *dev, const uint8_t proto)
{
}

/* OUTPUT_REPORT: alternative path for LED state on some hosts. */
static void on_output_report(const struct device *dev, const uint16_t len,
			     const uint8_t *const buf)
{
	on_set_report(dev, HID_REPORT_TYPE_OUTPUT, 0U, len, buf);
}

static struct hid_device_ops hid_ops = {
	.iface_ready   = on_iface_ready,
	.get_report    = on_get_report,
	.set_report    = on_set_report,
	.set_idle      = on_set_idle,
	.get_idle      = on_get_idle,
	.set_protocol  = on_set_protocol,
	.output_report = on_output_report,
};

/* ---- USBD message callback ---- */

/* Handles VBUS detection for boards with VBUS sensing. */
static void usbd_msg_cb(struct usbd_context *const ctx,
			const struct usbd_msg *const msg)
{
	if (usbd_can_detect_vbus(ctx)) {
		if (msg->type == USBD_MSG_VBUS_READY) {
			usbd_enable(ctx);
		}
		if (msg->type == USBD_MSG_VBUS_REMOVED) {
			usbd_disable(ctx);
		}
	}
}

/* ---- Public API ---- */

int kbd_bridge_init(void)
{
	int ret;

	/* Get the HID device node from the DTS overlay. */
	hid_dev = DEVICE_DT_GET_ONE(zephyr_hid_device);
	if (!device_is_ready(hid_dev)) {
		return -EIO;
	}

	/* Register boot-protocol keyboard descriptor and callbacks. */
	ret = hid_device_register(hid_dev, hid_report_desc,
				  sizeof(hid_report_desc), &hid_ops);
	if (ret) {
		return ret;
	}

	/* Initialize USBD context (enables VddUSB, configures USB1 PHY). */
	usbd_ctx = sample_usbd_init_device(usbd_msg_cb);
	return usbd_ctx ? 0 : -ENODEV;
}

int kbd_bridge_enable(void)
{
	if (!usbd_can_detect_vbus(usbd_ctx)) {
		return usbd_enable(usbd_ctx);
	}
	return 0;
}

int kbd_bridge_enqueue(const uint8_t report[KB_REPORT_SIZE])
{
	return k_msgq_put(&kb_msgq, report, K_NO_WAIT) ? -ENOMSG : 0;
}

void kbd_bridge_run(void)
{
	while (true) {
		uint8_t report[KB_REPORT_SIZE];

		/* Block until a report is available. */
		k_msgq_get(&kb_msgq, report, K_FOREVER);

		/* Drop if USB device not yet enumerated. */
		if (!hid_ready) {
			continue;
		}

		/* Copy to DMA-safe buffer and submit to PC. */
		memcpy(submit_buf, report, KB_REPORT_SIZE);
		hid_device_submit_report(hid_dev, KB_REPORT_SIZE, submit_buf);
	}
}
```

## src/kbd_bridge.h
```c
/*
 * USB HID Keyboard Bridge — device side API.
 *
 * Manages the USB device (OTG_HS1) that appears as a HID keyboard
 * to the PC, and provides the message queue for report forwarding.
 */

#ifndef KBD_BRIDGE_H
#define KBD_BRIDGE_H

#include <stdint.h>

/* Boot-protocol HID keyboard report size (8 bytes). */
#define KB_REPORT_SIZE 8

/* Initialize USB device stack and register HID keyboard.
 * Does NOT enable the device on the bus. */
int kbd_bridge_init(void);

/* Enable USB device on the bus. Call after usb_host_start(). */
int kbd_bridge_enable(void);

/* Consumer loop — reads reports from queue and sends to PC.
 * Blocks forever. Call as the last step in main(). */
void kbd_bridge_run(void);

/* Enqueue an 8-byte HID report for delivery to the PC.
 * Non-blocking. Returns 0 on success, -ENOMSG if queue full. */
int kbd_bridge_enqueue(const uint8_t report[KB_REPORT_SIZE]);

#endif
```

## src/usb_host.c
```c
/*
 * USB Host — ST USB Host Middleware on OTG_HS2.
 *
 * Runs the USBH_Process() state machine in a background thread,
 * forwards HID keyboard reports to the bridge queue, handles
 * USER1 button mode toggle, and forwards LED state.
 *
 * Hardware (STM32N6570-DK):
 *   USER1 button: PC13, active HIGH, pull-down
 *   LED2 (red):   PG10, active HIGH
 *   VBUS switch:  PB9 → STMPS2151 (controlled by usbh_conf.c)
 */

#include "usb_host.h"
#include "kbd_bridge.h"
#include "usbh_conf.h"

#include <zephyr/kernel.h>
#include <zephyr/logging/log.h>

#include "usbh_core.h"
#include "usbh_hid.h"
#include "usbh_hid_keybd.h"

LOG_MODULE_REGISTER(usb_host, LOG_LEVEL_INF);

static USBH_HandleTypeDef hUSBHost;
static volatile bool bridge_active = true;
static volatile uint8_t pending_leds;
static volatile bool leds_dirty;

/* ---- GPIO: button (PC13) and LED (PG10) ---- */

#define BTN_PORT   GPIOC
#define BTN_PIN    13U
#define LED_PORT   GPIOG
#define LED_PIN    10U

/* Configure button as input with pull-down, LED as push-pull output. */
static void gpio_init(void)
{
	__HAL_RCC_GPIOC_CLK_ENABLE();
	__HAL_RCC_GPIOG_CLK_ENABLE();

	/* PC13: input (00), pull-down (10). */
	BTN_PORT->MODER &= ~(3U << (BTN_PIN * 2U));
	BTN_PORT->PUPDR &= ~(3U << (BTN_PIN * 2U));
	BTN_PORT->PUPDR |= (2U << (BTN_PIN * 2U));

	/* PG10: output (01), push-pull. */
	LED_PORT->MODER &= ~(3U << (LED_PIN * 2U));
	LED_PORT->MODER |= (1U << (LED_PIN * 2U));
	LED_PORT->OTYPER &= ~(1U << LED_PIN);
}

/* Read USER1 button state (active HIGH). */
static inline bool button_pressed(void)
{
	return (BTN_PORT->IDR & (1U << BTN_PIN)) != 0;
}

/* Set LED2 on/off. */
static inline void led_set(bool on)
{
	if (on) {
		LED_PORT->BSRR = (1U << LED_PIN);
	} else {
		LED_PORT->BSRR = (1U << (LED_PIN + 16U));
	}
}

/* ---- ST middleware user callback ---- */

/* Called by the middleware on host state transitions. */
static void usbh_user_process(USBH_HandleTypeDef *phost, uint8_t id)
{
	if (id == HOST_USER_CONNECTION) {
		LOG_INF("Keyboard connected");
	} else if (id == HOST_USER_DISCONNECTION) {
		LOG_INF("Keyboard disconnected");
	} else if (id == HOST_USER_CLASS_ACTIVE) {
		LOG_INF("Keyboard ready");
	}
}

/* ---- HID event callback ---- */

/* Called by the ST HID class driver when a new interrupt-IN report
 * arrives from the keyboard. Enqueues the report for the bridge. */
void USBH_HID_EventCallback(USBH_HandleTypeDef *phost)
{
	HID_HandleTypeDef *hid;

	/* In mute mode, drop all reports. */
	if (!bridge_active) {
		return;
	}

	hid = (HID_HandleTypeDef *)phost->pActiveClass->pData;

	if (USBH_HID_GetDeviceType(phost) == HID_KEYBOARD &&
	    hid->length >= KB_REPORT_SIZE) {
		kbd_bridge_enqueue(hid->pData);
	}
}

/* ---- USBH process thread ---- */

#define USBH_STACK_SIZE 4096
#define USBH_PRIORITY   (CONFIG_MAIN_THREAD_PRIORITY + 1)

/* Background thread: runs the middleware state machine, polls the
 * button for mode toggle, and sends deferred LED updates. */
static void usbh_thread(void *p1, void *p2, void *p3)
{
	bool btn_prev = false;

	while (1) {
		/* Advance the middleware state machine. */
		USBH_Process(&hUSBHost);

		/* Edge-detect USER1 button (toggle on press, not hold). */
		bool btn_now = button_pressed();
		if (btn_now && !btn_prev) {
			bridge_active = !bridge_active;
			led_set(bridge_active);
			LOG_INF("Bridge %s", bridge_active ? "ON" : "OFF");
		}
		btn_prev = btn_now;

		/* Send deferred keyboard LED update.
		 * USBH_HID_SetReport is a multi-stage control transfer
		 * (SETUP → DATA → STATUS). Must be called repeatedly
		 * until it completes. */
		if (leds_dirty && hUSBHost.gState == HOST_CLASS) {
			static uint8_t led_buf;
			USBH_StatusTypeDef status;

			led_buf = pending_leds;
			leds_dirty = false;

			for (int i = 0; i < 200; i++) {
				status = USBH_HID_SetReport(&hUSBHost,
					0x02, 0x00, &led_buf, 1);
				if (status == USBH_OK || status == USBH_FAIL) {
					break;
				}
				USBH_Process(&hUSBHost);
				k_usleep(100);
			}
		}

		k_usleep(100);
	}
}

K_THREAD_STACK_DEFINE(usbh_stack, USBH_STACK_SIZE);
static struct k_thread usbh_thread_data;

/* ---- Public API ---- */

int usb_host_start(void)
{
	USBH_StatusTypeDef s;

	/* Initialize button and LED GPIO. */
	gpio_init();
	led_set(bridge_active);

	/* Initialize the ST USB Host Middleware.
	 * This calls USBH_LL_Init() → HAL_HCD_Init() → HAL_HCD_MspInit(). */
	s = USBH_Init(&hUSBHost, usbh_user_process, 0);
	if (s != USBH_OK) {
		return -EIO;
	}

	/* Register the HID class so keyboards are recognized. */
	s = USBH_RegisterClass(&hUSBHost, USBH_HID_CLASS);
	if (s != USBH_OK) {
		return -EIO;
	}

	/* Start the host — enables VBUS (PB9 HIGH) and begins
	 * watching for device connections. */
	s = USBH_Start(&hUSBHost);
	if (s != USBH_OK) {
		return -EIO;
	}

	/* Spawn the background thread for USBH_Process(). */
	k_thread_create(&usbh_thread_data, usbh_stack,
			K_THREAD_STACK_SIZEOF(usbh_stack),
			usbh_thread, NULL, NULL, NULL,
			USBH_PRIORITY, 0, K_NO_WAIT);
	k_thread_name_set(&usbh_thread_data, "usbh");

	return 0;
}

bool usb_host_bridge_active(void)
{
	return bridge_active;
}

/* Request a keyboard LED update (deferred to process thread). */
void usb_host_set_kbd_leds(uint8_t leds)
{
	pending_leds = leds;
	leds_dirty = true;
}
```

## src/usb_host.h
```c
/*
 * USB Host — public API.
 *
 * Manages the USB host (OTG_HS2) that reads a physical keyboard
 * on the USB-A port and feeds reports into the bridge queue.
 *
 * Also handles USER1 button (PC13) for mode toggle and
 * LED2 (PG10) as bridge mode indicator.
 */

#ifndef USB_HOST_H
#define USB_HOST_H

#include <stdbool.h>
#include <stdint.h>

/* Initialize USB host, VBUS power, button, LED, and start
 * the background USBH process thread. */
int usb_host_start(void);

/* Returns true when bridge is active (reports forwarded to PC). */
bool usb_host_bridge_active(void);

/* Forward keyboard LED state to the physical keyboard.
 * Bit 0=NumLock, 1=CapsLock, 2=ScrollLock. */
void usb_host_set_kbd_leds(uint8_t leds);

#endif
```

## src/usbh_conf.c
```c
/*
 * ST USB Host Middleware — HAL HCD callbacks and USBH_LL_* bridge.
 *
 * This file is boilerplate required by the ST middleware. It bridges
 * the middleware's abstract USBH_LL_* calls to the concrete HAL HCD
 * driver for USB2_OTG_HS.
 *
 * Hardware (STM32N6570-DK):
 *   USB2_OTG_HS: base 0x5806_0000, IRQ 178
 *   VBUS switch: PB9 → STMPS2151 (active HIGH, 100K pull-down)
 *   PHY clocks:  configured in main.c via LL API (not here)
 *   VddUSB:      enabled by Zephyr's udc_stm32 for USB1 (shared)
 */

#include "usbh_conf.h"
#include "usbh_core.h"
#include <zephyr/kernel.h>
#include <zephyr/irq.h>

/* HCD handle for OTG_HS2. */
HCD_HandleTypeDef hhcd_usb2;

/* ---- MSP init: clocks + IRQ ---- */

/* Called by HAL_HCD_Init(). Enables USB2 OTG and PHY clocks,
 * and connects the OTG_HS2 interrupt to Zephyr's IRQ subsystem. */
void HAL_HCD_MspInit(HCD_HandleTypeDef *hhcd)
{
	if (hhcd->Instance == USB2_OTG_HS) {
		__HAL_RCC_USB2_OTG_HS_CLK_ENABLE();
		__HAL_RCC_USB2_OTG_HS_PHY_CLK_ENABLE();

		IRQ_CONNECT(USB2_OTG_HS_IRQn, 7,
			    HAL_HCD_IRQHandler, &hhcd_usb2, 0);
		irq_enable(USB2_OTG_HS_IRQn);
	}
}

/* Called by HAL_HCD_DeInit(). Disables clocks and IRQ. */
void HAL_HCD_MspDeInit(HCD_HandleTypeDef *hhcd)
{
	if (hhcd->Instance == USB2_OTG_HS) {
		irq_disable(USB2_OTG_HS_IRQn);
		__HAL_RCC_USB2_OTG_HS_CLK_DISABLE();
		__HAL_RCC_USB2_OTG_HS_PHY_CLK_DISABLE();
	}
}

/* ---- HAL HCD ISR callbacks ---- */

/* SOF (Start of Frame): increments middleware timer for HID polling. */
void HAL_HCD_SOF_Callback(HCD_HandleTypeDef *hhcd)
{
	USBH_LL_IncTimer((USBH_HandleTypeDef *)hhcd->pData);
}

/* Device connect/disconnect. */
void HAL_HCD_Connect_Callback(HCD_HandleTypeDef *hhcd)
{
	USBH_LL_Connect((USBH_HandleTypeDef *)hhcd->pData);
}

void HAL_HCD_Disconnect_Callback(HCD_HandleTypeDef *hhcd)
{
	USBH_LL_Disconnect((USBH_HandleTypeDef *)hhcd->pData);
}

/* Port state changes. */
void HAL_HCD_PortEnabled_Callback(HCD_HandleTypeDef *hhcd)
{
	USBH_LL_PortEnabled((USBH_HandleTypeDef *)hhcd->pData);
}

void HAL_HCD_PortDisabled_Callback(HCD_HandleTypeDef *hhcd)
{
	USBH_LL_PortDisabled((USBH_HandleTypeDef *)hhcd->pData);
}

/* URB state change — middleware polls via USBH_LL_GetURBState(). */
void HAL_HCD_HC_NotifyURBChange_Callback(HCD_HandleTypeDef *hhcd,
					  uint8_t chnum,
					  HCD_URBStateTypeDef urb_state)
{
}

/* ---- USBH_LL_* : middleware-to-HAL bridge ---- */

/* Initialize the HCD for USB2_OTG_HS. Called by USBH_Init(). */
USBH_StatusTypeDef USBH_LL_Init(USBH_HandleTypeDef *phost)
{
	hhcd_usb2.Instance = USB2_OTG_HS;
	hhcd_usb2.Init.Host_channels = 16;
	hhcd_usb2.Init.speed = HCD_SPEED_HIGH;
	hhcd_usb2.Init.dma_enable = DISABLE;
	hhcd_usb2.Init.phy_itface = USB_OTG_HS_EMBEDDED_PHY;
	hhcd_usb2.Init.Sof_enable = ENABLE;
	hhcd_usb2.Init.low_power_enable = DISABLE;
	hhcd_usb2.Init.vbus_sensing_enable = DISABLE;
	hhcd_usb2.Init.use_external_vbus = DISABLE;

	/* Cross-link middleware and HCD handles. */
	hhcd_usb2.pData = phost;
	phost->pData = &hhcd_usb2;

	/* HAL_HCD_Init calls MspInit + USB_CoreInit + USB_HostInit. */
	if (HAL_HCD_Init(&hhcd_usb2) != HAL_OK) {
		return USBH_FAIL;
	}

	USBH_LL_SetTimer(phost, HAL_HCD_GetCurrentFrame(&hhcd_usb2));
	return USBH_OK;
}

USBH_StatusTypeDef USBH_LL_DeInit(USBH_HandleTypeDef *phost)
{
	HAL_HCD_DeInit(&hhcd_usb2);
	return USBH_OK;
}

/* Start/stop the host controller. */
USBH_StatusTypeDef USBH_LL_Start(USBH_HandleTypeDef *phost)
{
	HAL_HCD_Start(&hhcd_usb2);
	return USBH_OK;
}

USBH_StatusTypeDef USBH_LL_Stop(USBH_HandleTypeDef *phost)
{
	HAL_HCD_Stop(&hhcd_usb2);
	return USBH_OK;
}

/* Get the connected device's speed. */
USBH_SpeedTypeDef USBH_LL_GetSpeed(USBH_HandleTypeDef *phost)
{
	switch (HAL_HCD_GetCurrentSpeed(&hhcd_usb2)) {
	case 0:  return USBH_SPEED_HIGH;
	case 1:  return USBH_SPEED_FULL;
	case 2:  return USBH_SPEED_LOW;
	default: return USBH_SPEED_FULL;
	}
}

/* Reset the USB port. */
USBH_StatusTypeDef USBH_LL_ResetPort(USBH_HandleTypeDef *phost)
{
	HAL_HCD_ResetPort(&hhcd_usb2);
	return USBH_OK;
}

/* Get the byte count of the last completed transfer. */
uint32_t USBH_LL_GetLastXferSize(USBH_HandleTypeDef *phost, uint8_t pipe)
{
	return HAL_HCD_HC_GetXferCount(&hhcd_usb2, pipe);
}

/* Open a host channel (pipe) for a specific endpoint. */
USBH_StatusTypeDef USBH_LL_OpenPipe(USBH_HandleTypeDef *phost,
				     uint8_t pipe, uint8_t epnum,
				     uint8_t dev_address, uint8_t speed,
				     uint8_t ep_type, uint16_t mps)
{
	HAL_HCD_HC_Init(&hhcd_usb2, pipe, epnum, dev_address,
			speed, ep_type, mps);
	return USBH_OK;
}

/* Close (halt) a host channel. */
USBH_StatusTypeDef USBH_LL_ClosePipe(USBH_HandleTypeDef *phost, uint8_t pipe)
{
	HAL_HCD_HC_Halt(&hhcd_usb2, pipe);
	return USBH_OK;
}

/* Submit a USB request block (URB) to a host channel. */
USBH_StatusTypeDef USBH_LL_SubmitURB(USBH_HandleTypeDef *phost,
				      uint8_t pipe, uint8_t direction,
				      uint8_t ep_type, uint8_t token,
				      uint8_t *pbuff, uint16_t length,
				      uint8_t do_ping)
{
	HAL_HCD_HC_SubmitRequest(&hhcd_usb2, pipe, direction,
				 ep_type, token, pbuff, length, do_ping);
	return USBH_OK;
}

/* Get the current URB state for a host channel. */
USBH_URBStateTypeDef USBH_LL_GetURBState(USBH_HandleTypeDef *phost,
					  uint8_t pipe)
{
	return (USBH_URBStateTypeDef)HAL_HCD_HC_GetURBState(&hhcd_usb2, pipe);
}

/* Drive VBUS power to the USB-A port.
 * PB9 controls a STMPS2151 load switch (active HIGH).
 * Uses direct register writes to avoid linking HAL GPIO. */
USBH_StatusTypeDef USBH_LL_DriverVBUS(USBH_HandleTypeDef *phost, uint8_t state)
{
	__HAL_RCC_GPIOB_CLK_ENABLE();

	/* PB9: output, push-pull. */
	GPIOB->MODER &= ~(3U << (9U * 2U));
	GPIOB->MODER |= (1U << (9U * 2U));
	GPIOB->OTYPER &= ~(1U << 9U);

	/* Set or clear PB9. */
	if (state) {
		GPIOB->BSRR = (1U << 9U);
	} else {
		GPIOB->BSRR = (1U << (9U + 16U));
	}

	/* Wait for VBUS to stabilize. */
	k_msleep(200);
	return USBH_OK;
}

/* DATA0/DATA1 toggle tracking for reliable transfers. */
USBH_StatusTypeDef USBH_LL_SetToggle(USBH_HandleTypeDef *phost,
				      uint8_t pipe, uint8_t toggle)
{
	HCD_HCTypeDef *hc = &hhcd_usb2.hc[pipe & 0xFU];

	if (hc->ep_is_in) {
		hc->toggle_in = toggle;
	} else {
		hc->toggle_out = toggle;
	}
	return USBH_OK;
}

uint8_t USBH_LL_GetToggle(USBH_HandleTypeDef *phost, uint8_t pipe)
{
	HCD_HCTypeDef *hc = &hhcd_usb2.hc[pipe & 0xFU];

	return hc->ep_is_in ? hc->toggle_in : hc->toggle_out;
}

/* Delay function mapped to Zephyr's scheduler. */
void USBH_Delay(uint32_t Delay)
{
	k_msleep(Delay);
}
```

## src/usbh_conf.h
```c
/*
 * ST USB Host Middleware — compile-time configuration.
 *
 * Defines resource limits, memory functions, and debug level
 * for the middleware. Also provides the HCD handle declaration.
 */

#ifndef USBH_CONF_H
#define USBH_CONF_H

#include <stm32n6xx_hal.h>
#include <zephyr/kernel.h>
#include <stdio.h>
#include <stdlib.h>
#include <string.h>

/* Resource limits for HID keyboard use case. */
#define USBH_MAX_NUM_ENDPOINTS       2    /* EP0 + 1 interrupt-IN */
#define USBH_MAX_NUM_INTERFACES      2
#define USBH_MAX_NUM_CONFIGURATION   1
#define USBH_MAX_NUM_SUPPORTED_CLASS 1    /* HID only */
#define USBH_MAX_SIZE_CONFIGURATION  256
#define USBH_MAX_DATA_BUFFER         512

/* Debug: 0=off, 1=errors, 2=warnings, 3=all. */
#define USBH_DEBUG_LEVEL 0

/* Map middleware memory functions to Zephyr. */
#define USBH_malloc   k_malloc
#define USBH_free     k_free
#define USBH_memset   memset
#define USBH_memcpy   memcpy

/* Debug printf mapping (only used if USBH_DEBUG_LEVEL > 0). */
#if (USBH_DEBUG_LEVEL > 0U)
#define USBH_UsrLog(...)   do { printf("USBH USR: "); printf(__VA_ARGS__); printf("\n"); } while (0)
#else
#define USBH_UsrLog(...)
#endif

#if (USBH_DEBUG_LEVEL > 1U)
#define USBH_ErrLog(...)   do { printf("USBH ERR: "); printf(__VA_ARGS__); printf("\n"); } while (0)
#else
#define USBH_ErrLog(...)
#endif

#if (USBH_DEBUG_LEVEL > 2U)
#define USBH_DbgLog(...)   do { printf("USBH DBG: "); printf(__VA_ARGS__); printf("\n"); } while (0)
#else
#define USBH_DbgLog(...)
#endif

/* HCD handle for OTG_HS2 (defined in usbh_conf.c). */
extern HCD_HandleTypeDef hhcd_usb2;

#endif
```
